## apps/firmware/main/Kconfig.projbuild
```kconfig
menu "Memora firmware"

config MEMORA_WIFI_SSID
    string "Wi-Fi SSID"
    default ""

config MEMORA_WIFI_PASSWORD
    string "Wi-Fi password"
    default ""

config MEMORA_LIVEKIT_SERVER_URL
    string "LiveKit server URL"
    default "wss://"

config MEMORA_TOKEN_URL
    string "Dashboard token endpoint URL"
    default "https://dashboard-production-43b8.up.railway.app/api/token"
    help
        HTTPS POST endpoint exposed by the deployed dashboard. It mints a
        LiveKit join token and dispatches the backend agent for the requested
        room. Override this with a LAN URL for local development.

config MEMORA_LIVEKIT_TOKEN
    string "Fallback pre-generated LiveKit token"
    default ""

config MEMORA_LIVEKIT_ROOM
    string "LiveKit room"
    default "memora-test"

config MEMORA_LIVEKIT_IDENTITY
    string "LiveKit participant identity"
    default "memora-device"

config MEMORA_INGEST_URL
    string "Backend video ingest URL"
    default "https://backend-production-f5b2.up.railway.app/api/media/video/frame"
    help
        HTTPS POST endpoint on the deployed backend Video Bridge. The ESP
        sends raw JPEG frames here (Content-Type: image/jpeg) at 1 FPS.
        Override this with a LAN URL for local development.

endmenu
```
